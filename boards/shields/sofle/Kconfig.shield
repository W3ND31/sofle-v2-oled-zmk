## boards/shields/sofle/Kconfig.shield
```kconfig
# Copyright (c) 2020 The ZMK Contributors
# SPDX-License-Identifier: MIT

config SOFLE_CENTRAL_DONGLE
    def_bool $(shields_list_contains,sofle_central_dongle)
```

## config/boards/shields/sofle_dongle/Kconfig.shield
```kconfig
# Copyright (c) 2020 The ZMK Contributors
# SPDX-License-Identifier: MIT

config SHIELD_SOFLE_DONGLE_LEFT
    def_bool $(shields_list_contains,sofle_dongle_left)

config SHIELD_SOFLE_DONGLE_RIGHT
    def_bool $(shields_list_contains,sofle_dongle_right)

config SHIELD_SOFLE_DONGLE_CENTRAL
    def_bool $(shields_list_contains,sofle_dongle_central)
```

## config/west.yml
```yaml
manifest:
  remotes:
    - name: zmkfirmware
      url-base: https://github.com/zmkfirmware
    - name: wendel
      url-base: https://github.com/W3ND31
    - name: mctechnology17 #new entry
      url-base: https://github.com/mctechnology17 #new entry
  projects:
    - name: zmk
      remote: zmkfirmware
      revision: main
      import: app/west.yml
    - name: zmk-nice-oled
      remote: wendel
      revision: test-font
    # - name: zmk-nice-oled #new entry
    #   remote: mctechnology17 #new entry
    #   revision: main #new entry
  self:
    path: config
```
